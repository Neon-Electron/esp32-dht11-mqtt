## sdkconfig.defaults
```kconfig
# WiFi Configuration
CONFIG_ESP_WIFI_SSID="WiFi_SSID"
CONFIG_ESP_WIFI_PASSWORD="WiFi_Pass"
CONFIG_ESP_MAXIMUM_RETRY=5

# FreeRTOS Configuration
CONFIG_FREERTOS_HZ=1000
CONFIG_FREERTOS_USE_TRACE_FACILITY=y
CONFIG_FREERTOS_USE_STATS_FORMATTING_FUNCTIONS=y

# Logging Configuration
CONFIG_LOG_DEFAULT_LEVEL_INFO=y
CONFIG_LOG_DEFAULT_LEVEL=3

# GPIO Configuration
CONFIG_GPIO_ESP32_SUPPORT_SWITCH_SLP_PULL=y

# NVS Configuration
CONFIG_NVS_ENCRYPTION=n

# Network Configuration
CONFIG_LWIP_SO_REUSE=y
CONFIG_LWIP_SO_RCVBUF=y

# DHT Sensor Configuration (if using esp-idf-lib)
CONFIG_DHT_TASK_STACK_SIZE=2048
CONFIG_DHT_TASK_PRIORITY=5
```
